## CMakeLists.txt
```
# SPDX-License-Identifier: Apache-2.0

cmake_minimum_required(VERSION 3.28.0)

find_package(Zephyr REQUIRED HINTS $ENV{ZEPHYR_BASE})
project(mrubyc-zephyr)

target_sources(app PRIVATE
	src/main.c
	src/blink.c
	mrubyc/src/alloc.c
	mrubyc/src/c_array.c
	mrubyc/src/c_hash.c
	mrubyc/src/c_math.c
	mrubyc/src/c_numeric.c
	mrubyc/src/c_object.c
	mrubyc/src/c_proc.c
	mrubyc/src/c_range.c
	mrubyc/src/c_string.c
	mrubyc/src/c_task_queue.c
	mrubyc/src/class.c
	mrubyc/src/console.c
	mrubyc/src/error.c
	mrubyc/src/global.c
	mrubyc/src/keyvalue.c
	mrubyc/src/load.c
	mrubyc/src/mrblib.c
	mrubyc/src/rrt0.c
	mrubyc/src/symbol.c
	mrubyc/src/value.c
	mrubyc/src/vm.c
	mrubyc/hal/zephyr/hal.c
)

target_include_directories(app PRIVATE
	mrubyc/src
	mrubyc/hal/zephyr
)
```

## prj.conf
```kconfig
CONFIG_GPIO=y

# mruby/c requirements
CONFIG_HEAP_MEM_POOL_SIZE=65536
CONFIG_MAIN_THREAD_PRIORITY=0
CONFIG_IDLE_STACK_SIZE=512
```

## src/main.c
```c
/*
 * Copyright (c) 2012-2014 Wind River Systems, Inc.
 *
 * SPDX-License-Identifier: Apache-2.0
 */

#include <stdint.h>
#include <zephyr/kernel.h>
#include <zephyr/sys/printk.h>
#include "mrubyc.h"

#define MRBC_MEMORY_SIZE (1024 * 40)

static uint8_t memory_pool[MRBC_MEMORY_SIZE] __aligned(4);
extern const uint8_t blink[];

int main(void)
{
	mrbc_init(memory_pool, MRBC_MEMORY_SIZE);
	if (mrbc_create_task(blink, NULL) == NULL) {
		printk("Failed to create mruby/c task\n");
		return -1;
	}

	return mrbc_run();
}
```

## src/blink.c
```c
#include <stdint.h>
#ifdef __cplusplus
extern
#endif
const uint8_t blink[] = {
0x52,0x49,0x54,0x45,0x30,0x34,0x30,0x30,0x00,0x00,0x00,0x67,0x48,0x53,0x4d,0x4b,
0x30,0x30,0x30,0x30,0x49,0x52,0x45,0x50,0x00,0x00,0x00,0x4b,0x30,0x34,0x30,0x30,
0x00,0x00,0x00,0x3f,0x00,0x01,0x00,0x04,0x00,0x00,0x00,0x00,0x00,0x00,0x00,0x13,
0x00,0x5c,0x02,0x00,0x2f,0x01,0x00,0x01,0x07,0x02,0x2f,0x01,0x01,0x01,0x26,0xff,
0xef,0x40,0x76,0x00,0x01,0x00,0x00,0x05,0x42,0x6c,0x69,0x6e,0x6b,0x00,0x00,0x02,
0x00,0x04,0x70,0x75,0x74,0x73,0x00,0x00,0x05,0x73,0x6c,0x65,0x65,0x70,0x00,0x45,
0x4e,0x44,0x00,0x00,0x00,0x00,0x08,
};
```
